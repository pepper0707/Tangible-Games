// ===== Libary Includes =====
#include "AS5600.h"             // Magnetic Encoder
#include <Adafruit_NeoPixel.h>  // LED Strip
#include "TM1637.h"             // Segment Displays
#include <PCM.h>                // This is for playing sounds, it breaks pwm on certain pins CAREFUL
#include <EEPROM.h>             //Non volitale memory

// ===== Sound Data =====

// Sound effect for successful hit
const unsigned char hit[] PROGMEM = {
133, 132, 135, 135, 135, 133, 131, 130, 128, 127, 126, 124,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 131, 
};

// Sound effect for missed led
const unsigned char miss[] PROGMEM = {
129, 129, 129, 129, 129, 128, 128, 129, 128, 128, 128, 128,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 130,
};

// Countdown Sound effect for second (e.g, 3,2,1..)
const unsigned char secondCount[] PROGMEM = {
129, 130, 130, 132, 132, 134, 137, 139, 142, 144, 147, 150,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 126,
};

// Countdown Sound effect for go (e.g., ...GO)
const unsigned char goCount[] PROGMEM = {
127, 127, 127, 127, 128, 127, 126, 127, 128, 128, 128, 128,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 134,
};

// ===== Magnetic Encoder  =====
//  Uncomment the line according to your sensor type
//AS5600L as5600;   //  use default Wire
AS5600 as5600;   //  use default Wire
//int magnetStatus = 0; //value of the status register (MD, ML, MH)
//int magnetStrength = 0;

// ===== EEPROM Configuration =====
const int addrHighScore = 0;      // EEPROM address for high score value
const int addrName = 20;          // EEPROM address for high score name
const int addrFlag = 100;         // EEPROM address for initialization flag
const uint8_t initFlag = 123;     // Unique value to mark EEPROM initialization

// ===== Hardware Pins =====
// Keeping the pins for the display on non pwm pins seems to fix issues with charcters sometimes not displaying correctly. Most likely some sort of timing issue.
const uint8_t CLK1 = 2;
const uint8_t DIO1 = 8; 
const uint8_t CLK2 = 4;
const uint8_t DIO2 = 13;
const uint8_t CLK3 = 12;
const uint8_t DIO3 = 7;
const uint8_t buttonPin = 6;      // Pushbutton pin
const uint8_t neoPixelPin = 10;   // LED strip control pin

// ===== NeoPixel Configuration =====
const uint8_t numPixels = 60;      // Number of pixels in the strip

// ===== Game Configuration =====
// LED spawning parameters
#define MAX_FLASHING_LEDS 3
#define LED_SPAWN_MIN 1000        // Min spawn delay in ms
#define LED_SPAWN_MAX 3000        // Max spawn delay in ms
const unsigned long normalLifespan = 4000;   // Regular LED lifespan
const unsigned long specialLifespan = 6000; // Special LED lifespan
const uint8_t colorCRarityDefault = 10;       // % chance for special colorC
const uint8_t maxSameColor = 3;              // Max times same color can appear in a row
const uint8_t aimedLedDeadzone = 3;          // Deadzone around aimed position. This applies either side, so total deadzone area is 2x this
const uint8_t existingLedsDeadzone = 2;      // Minimum spacing between LEDs. This applies either side, so total deadzone area is 2x this
const uint8_t commonScoring = 5;            // Base points when collecting a common led (colorA or colorB)
const uint8_t specialScoring = 15;           // Base points when collecting a special led (colorC)

// Timing Paramaters
const unsigned long clockwiseCheckInterval = 300;  // Rotation direction check interval
const unsigned long clockDuration = 60000;    // Game duration (60 seconds)
const unsigned long incorrectResetTime = 750;  // Time before resetting "passed" state. Fall back from resetting on led collection
const unsigned long debounceDelay = 50;        // Button debounce time

// Blinking Rate
const float initialBlinkProportion = 0.125f; // 12.5% of lifespan
const float blinkAcceleration = 0.72f;
const int minBlinkDelay = 30;

// Animation parameters
const uint16_t colorChangeInterval = 2000;    // Time between color changes in idle mode
const uint8_t blinkFrequency = 50;           // LED blink rate
const unsigned long displayUpdateInterval = 1500;  // Display update interval
const unsigned long printInterval = 100;       // Print interval for clock
// Animation Variable
uint8_t chase_q = 0; // Chase animation queue

// ===== Game State Variables =====
uint8_t combo = 1;                // Current combo multiplier
uint16_t score = 0;               // Current game score
uint16_t highScore;               // Current HighScore
int aimedAtLed;                   // Currently aimed at LED
bool gameStarted = false;         // Game state tracking
bool firstGame = true;            // First game indicator
bool timerRunning = true;         // Timer state
bool useAltColor;                 // Color alternation flag
bool displayToggle = true;        // Display alternation for blinking
uint8_t colorCRarity;             // Current rarity setting for colorC

// ===== Input Tracking =====
uint8_t buttonState;              // Current button state
uint8_t lastButtonState = LOW;    // Previous button state
unsigned long lastDebounceTime = 0;  // The last time the button output pin was toggled
float lastAngle;                  // Last recorded angle for direction detection
bool isClockwise;                 // Current rotation direction

// ===== Timing Variables =====
unsigned long randomSpawnRate = 0;     // Next random spawn time
unsigned long previousMillis = 0;      // Clock Previous Millis
unsigned long clockStartTime;          // Game start time
unsigned long previousPrint = 0;       // Last clock print time
unsigned long chasePreviousMillis = 0; // For theater chase animation
unsigned long lastDisplayUpdate = 0;   // For display updates
unsigned long lastBlinkUpdate = 0;     // For blinking effects

// ===== User Interface =====
char buf[5];                      // Buffer for formatting display numbers
char highScoreName[5];            // Storage for high score name
char alphabet[] = {
  '-', 'A', 'B', 'C', 'D', 'E', 'F', 'G', 'H', 'I', 'J', 'K', 'L', 
  'M', 'N', '0', 'P', 'Q', 'R', 'S', 'T', 'U', 'V', 'W', 'X', 'Y', 'Z'
};

// ===== Object Initialization =====
Adafruit_NeoPixel strip = Adafruit_NeoPixel(numPixels, neoPixelPin, NEO_GRB + NEO_KHZ800);
TM1637 scoreDisplay(CLK1, DIO1);
TM1637 comboDisplay(CLK2, DIO2);
TM1637 clockDisplay(CLK3, DIO3);


// ===== NeoPixel Colors =====
const uint32_t colorA = strip.Color(255, 0, 255); // Pink
const uint32_t colorB = strip.Color(0, 255, 255); // Cyan
const uint32_t colorC = strip.Color(57, 255, 20); // Green

// Structure for a flashing LED
struct FlashingLED {
  // State flags
  bool active = false;            // Whether this LED is currently active
  bool ledOn;                     // Current LED illumination state
  bool beenPassed;                // Whether LED has been passed but not collected
  bool passedClockwise;           // Direction LED was passed in
  bool hasLeftPixel;              // Whether we've moved away after passing
  
  // Position information
  uint8_t pixel;                  // LED position on the strip
  
  // Visual properties
  uint32_t color;                 // LED color
  
  // Timing variables
  unsigned long startTime;        // When LED was spawned
  unsigned long lastToggleTime;   // Last time LED was toggled
  unsigned long passedTime;       // When LED was passed
  int delayTime;                  // Current blinking interval
};

// Array of active LEDs
FlashingLED flashingLeds[MAX_FLASHING_LEDS];

enum ButtonEvent {  // Button event types
  BUTTON_NONE,      // No button event
  BUTTON_PRESS,     // Short press
  BUTTON_HOLD       // Long press/hold
};



void setup()
{
  Serial.begin(115200);

  uint8_t flag;
  EEPROM.get(addrFlag, flag);

  if (flag != initFlag) {                           // First run,  initialize high score
    char emptyName[5];
    for (int i = 0; i < 4; i++) {
      emptyName[i] = '-';
    }
    emptyName[4] = '\0';

    EEPROM.put(addrName, emptyName);
    EEPROM.put(addrHighScore, (uint16_t)0);
    EEPROM.put(addrFlag, initFlag);
    Serial.println("EEPROM initialized.");
  } else {
    Serial.println("EEPROM already initialized.");
  }

  EEPROM.get(addrHighScore, highScore);
  EEPROM.get(addrName, highScoreName);
  if (highScore > 9999) highScore = 9999;
  //led:
  randomSeed(analogRead(0));          // Gets random seed using random data from empty analog pin
  
  randomSpawnRate = 1000;             // First LED spawns after 1 second
  
  strip.begin();                    // Initialize the LED strip
  strip.clear();                   // Turn off all LEDs
  strip.show();                   // Update the strip

  Serial.println(__FILE__);
  Serial.print("AS5600_LIB_VERSION: ");
  Serial.println(AS5600_LIB_VERSION);
  Serial.println();

  Wire.begin();

  //as5600.begin(13);  //  set direction pin.
  as5600.setDirection(AS5600_CLOCK_WISE);  //  default, just be explicit.
  int b = as5600.isConnected();
  Serial.print("Connect: ");
  Serial.println(b);

  scoreDisplay.init();
  scoreDisplay.set(BRIGHT_TYPICAL);//BRIGHT_TYPICAL = 2,BRIGHT_DARKEST = 0,BRIGHTEST = 7;

  comboDisplay.init();
  comboDisplay.set(BRIGHT_TYPICAL);//BRIGHT_TYPICAL = 2,BRIGHT_DARKEST = 0,BRIGHTEST = 7;

  clockDisplay.init();
  clockDisplay.set(BRIGHT_TYPICAL);//BRIGHT_TYPICAL = 2,BRIGHT_DARKEST = 0,BRIGHTEST = 7;

  scoreDisplay.displayStr((char *)"lets");
  comboDisplay.displayStr((char *)"play");
  
  
  // Initialize the pushbutton pin as an input:
  pinMode(buttonPin, INPUT_PULLUP);

  buttonState = digitalRead(buttonPin);
  lastButtonState = buttonState;

  //checkMagnetPresence();
}


void loop() {
  if (!gameStarted) {
    theaterChase();
    displayIdle();

    switch (GetButtonState(3000)) {
      case BUTTON_PRESS:
        StartGame();
        break;
      case BUTTON_HOLD:
        ResetHighScore();
        break;
      default:
        break;
    }
  }

  if (gameStarted) {                                              // If game has started, run game logic
    unsigned long clockCurrentMillis = millis();
    unsigned long elapsed = clockCurrentMillis - clockStartTime;

    if (clockCurrentMillis - previousPrint >= printInterval) {    // Only print every printInterval ms
      previousPrint = clockCurrentMillis;

      float remaining = (clockDuration - elapsed) / 1000.0;
      if (remaining < 0) remaining = 0;


      sprintf(buf, "%-4d", combo);  
      comboDisplay.displayStr(buf);
      clockDisplay.displayNum(remaining,2);

      if (elapsed >= clockDuration) {                               // If time's up
        endGame();
      }
    }

    Game();

  }
}

ButtonEvent GetButtonState(unsigned long holdThreshold) {
  int reading = digitalRead(buttonPin);
  unsigned long currentMillis = millis();
  static unsigned long pressStartTime = 0;
  static bool holdEventFired = false;

  if (reading != lastButtonState) {
    lastDebounceTime = currentMillis;
  }

  if ((currentMillis - lastDebounceTime) > debounceDelay) {
    if (reading != buttonState) {
      buttonState = reading;

      if (buttonState == LOW) {
        // Button just pressed
        pressStartTime = currentMillis;
        holdEventFired = false;
      } else {
        // Button just released
        if (!holdEventFired && (currentMillis - pressStartTime < holdThreshold)) {
          return BUTTON_PRESS;
        }
      }
    }

    // While the button is still held
    if (buttonState == LOW && !holdEventFired && (currentMillis - pressStartTime >= holdThreshold)) {
      holdEventFired = true;
      return BUTTON_HOLD;
    }
  }

  lastButtonState = reading;
  return BUTTON_NONE;
}

void ResetHighScore(){
  highScore = 0;
  EEPROM.put(addrHighScore, highScore);
  startPlayback(secondCount, sizeof(secondCount));
}

void endGame() {
  strip.clear();  //turn off all LEDs
  strip.show();   //update the strip

  scoreDisplay.displayStr((char *)"Turn");
  comboDisplay.displayStr((char *)"0ver");

  delay(2000);
  if(score > highScore){
    NameInput();
    highScore = score;
    if (highScore > 9999) highScore = 9999;
    EEPROM.put(addrHighScore, highScore);
  }
  
  gameStarted = false;
  firstGame = false;
}

void NameInput() {

  char name[5] = { '\0' };  // Room for 4 letters + null terminator
  int lettersEntered = 0;
  int pixel;
  bool blinkToggle = true;

  bool displayToggle = true;

  clockDisplay.displayNum(0);
  comboDisplay.clearDisplay();

  for(int i = 0; i<10; i++){
    if(displayToggle){
      comboDisplay.displayStr((char *)"HiSc");
      scoreDisplay.displayStr((char *)"HiSc");
      clockDisplay.displayStr((char *)"HiSc");
    }else{
      comboDisplay.displayStr((char *)"    ");
      scoreDisplay.displayStr((char *)"    ");
      clockDisplay.displayStr((char *)"    ");
    }
    displayToggle = !displayToggle;
    delay(300);
  }

  scoreDisplay.displayStr((char *)"entr");
  clockDisplay.displayStr((char *)"plyr");

  while (lettersEntered < 4) {
    float angle = as5600.rawAngle() * AS5600_RAW_TO_DEGREES;
    int aimedAtLetter = (int)((angle / 360.0) * 27) % 27;
    char currentLetter = alphabet[aimedAtLetter];

    unsigned long currentMillis = millis();


    strip.setPixelColor(pixel, 0);
    strip.setPixelColor(pixel - 1, 0);  
    strip.setPixelColor(pixel + 1, 0);


    char displayBuffer[5];
    strncpy(displayBuffer, name, 4);  // Copy up to 4 chars
    displayBuffer[4] = '\0';          // Ensure null-termination


    if (currentMillis - lastBlinkUpdate >= 150) {
      lastBlinkUpdate = currentMillis;
      if (blinkToggle) {
        displayBuffer[lettersEntered] = currentLetter;
        displayBuffer[lettersEntered + 1] = '\0';  // Ensure null-termination
        comboDisplay.displayStr(displayBuffer);

      } else {
        displayBuffer[lettersEntered] = ' ';
        displayBuffer[lettersEntered + 1] = '\0';  // Ensure null-termination
        comboDisplay.displayStr(displayBuffer);
      }

      blinkToggle = !blinkToggle;
    }

    float ledsPerLetter = (float)numPixels / 27.0;  // 60/27 ≈ 2.22
    const int pixelOffset = -2;
    pixel = (numPixels - 1 - (int)(aimedAtLetter * ledsPerLetter) + pixelOffset) % numPixels;


    strip.setPixelColor(pixel, colorA);
    strip.setPixelColor(pixel - 1, colorA);
    strip.setPixelColor(pixel + 1, colorA);
    strip.show();

    switch (GetButtonState(1000)) {
      case BUTTON_PRESS:
        //lock in the current letter
        name[lettersEntered] = currentLetter;  // Temporarily add the currently selected letter at the current position
        lettersEntered++;
        name[lettersEntered] = '\0';  // Make sure null terminator is in place (after the last locked letter)
        //startPlayback(secondCount, sizeof(secondCount));  // Wanted to play a sound when locking in letter but for some reason it's very low pitched
        break;

      case BUTTON_HOLD:               // Hold to go back a letter
        if (lettersEntered > 0) {
          lettersEntered--;
          name[lettersEntered] = '\0';  // Clear that slot
        }
        break;

      default:
        break;
    }
  }

  strcpy(highScoreName, name);  // Copy the contents of name into highScoreName
  EEPROM.put(addrName, highScoreName);
}

void displayIdle(){
  unsigned long currentMillis = millis();

  if (currentMillis - lastDisplayUpdate >= displayUpdateInterval) {
    lastDisplayUpdate = currentMillis;
    scoreDisplay.clearDisplay();
    comboDisplay.clearDisplay();
    clockDisplay.displayNum(0);

    if(displayToggle){
      if(firstGame){
        scoreDisplay.displayStr((char *)"lets");
        comboDisplay.displayStr((char *)"play");
        clockDisplay.displayStr((char *)"    ");
      }else{
        scoreDisplay.displayStr((char *)"PrSc");
        comboDisplay.displayNum(score);
        clockDisplay.displayStr((char *)"    ");
      }
    }else{
      scoreDisplay.displayStr((char *)"HiSc");
      if(highScore <= 0){
        comboDisplay.displayStr((char *)"0000");
        clockDisplay.displayStr((char *)"----");
      }else{
        comboDisplay.displayNum(highScore);
        clockDisplay.displayStr(highScoreName);
      }
    }

    displayToggle = !displayToggle;

  }
}

void StartGame() {
  DifficultySelect();
  combo = 1;
  score = 0;
  
  memset(flashingLeds, 0, sizeof(flashingLeds));

  scoreDisplay.clearDisplay();
  comboDisplay.clearDisplay();
  clockDisplay.clearDisplay();

  for (int i = 3; i >= 1; i--) {
    useAltColor = !useAltColor;
    startPlayback(secondCount, sizeof(secondCount));
    scoreDisplay.displayNum(i);
    comboDisplay.displayNum(i);
    clockDisplay.displayNum(i);
    for (int i = 0; i < numPixels; i++) {
        strip.setPixelColor(i, useAltColor ? colorA : colorB);
      }
    strip.show();
    delay(1000);
  }

  strip.clear();  //turn off all LEDs
  strip.show();   //update the strip

  startPlayback(goCount, sizeof(goCount));
  scoreDisplay.displayStr((char *)"G0");
  comboDisplay.displayStr((char *)"G0");
  clockDisplay.displayStr((char *)"G0");
  delay(1500);
  scoreDisplay.displayStr((char *)"0000");
  gameStarted = true;
  clockStartTime = millis(); // Start the timer

}

void DifficultySelect() {
  bool selecting = true;
  strip.clear();
  strip.show();

  scoreDisplay.displayStr((char *)"diff");
  comboDisplay.displayStr((char *)"    ");
  clockDisplay.displayStr((char *)"    ");

  while (selecting) {
    float angle = as5600.rawAngle() * AS5600_RAW_TO_DEGREES;
    aimedAtLed = round((angle / 360.0) * 61) % 61;
    aimedAtLed = (numPixels)-aimedAtLed;  // Reverse direction
    aimedAtLed -= 1;

    // First, clear all LEDs
    for (int i = 0; i < numPixels; i++) {
      strip.setPixelColor(i, 0);  // Set all to off
    }
    
    bool selectedHalf = (aimedAtLed < numPixels / 2);

    uint8_t start;
    uint8_t end;
    uint32_t color;

    if(!selectedHalf){
      start = numPixels / 2;
      end = numPixels;
      color = colorA;
      clockDisplay.displayStr((char *)"   1");
    }else{
      start = 0;
      end = numPixels / 2;
      color = colorC;
      clockDisplay.displayStr((char *)"   2");
    }

    for (int i = start; i < end; i++) {
      strip.setPixelColor(i, color);
    }

    strip.show();
    switch (GetButtonState(3000)) {
      case BUTTON_PRESS:
        selecting = false;
        colorCRarity = selectedHalf ? colorCRarityDefault : 0;
        useAltColor = true;
        break;
      case BUTTON_HOLD:
        break;
      default:
        break;
    }
  }
}

void Game() {
  float angle = as5600.rawAngle() * AS5600_RAW_TO_DEGREES;

  aimedAtLed = round((angle / 360.0) * 61) % 61;
  aimedAtLed = (numPixels)-aimedAtLed;  // Reverse direction
  aimedAtLed -= 1;

  aimedAtLed = (aimedAtLed + numPixels) % numPixels; // Account for wrap around

  unsigned long currentMillis = millis();
  if (currentMillis - previousMillis > clockwiseCheckInterval) {
    previousMillis = currentMillis;
    lastAngle = angle;
  }

  float angleDelta = angle - lastAngle;

  if (angleDelta > 180.0) {
    angleDelta -= 360.0;
  } else if (angleDelta < -180.0) {
    angleDelta += 360.0;
  }

  isClockwise = angleDelta > 0;
  isClockwise = !isClockwise;

  // Serial.print("last Angle: ");
  // Serial.println(lastAngle);
  //Serial.print("current angle: ");
  //Serial.println(as5600.rawAngle() * AS5600_RAW_TO_DEGREES);
  //Serial.print("Clockwise: ");
  //Serial.println(isClockwise);
  updateFlashingLEDs();  //update all flashing LEDs

  static unsigned long lastTrigger = 0;
  if (millis() - lastTrigger > randomSpawnRate) {  //check if its time to spawn a new LED
    lastTrigger = millis();
    startFlashingLED(GetRandomPixel());  //start the LED flashing
  }

  randomSpawnRate = random(LED_SPAWN_MIN, LED_SPAWN_MAX);  //randomize the next spawn rate

  //Serial.print("aimed at led: ");
  //Serial.println(aimedAtLed);

  for (int i = 0; i < MAX_FLASHING_LEDS; i++) {
    if (!flashingLeds[i].active) continue;  //skip inactive LEDs

    int forward = (flashingLeds[i].pixel - aimedAtLed + numPixels) % numPixels;
    int backward = (aimedAtLed - flashingLeds[i].pixel + numPixels) % numPixels;
    int delta = min(forward, backward);

    if (delta<=1) {

      // Serial.print("aimed at led: ");
      // Serial.println(aimedAtLed);
      //Serial.print("led pixel: ");
      //Serial.println(flashingLeds[i].pixel);
      //Serial.println("HIT!!!!!!!!!!!!!!!!");

      if (flashingLeds[i].color == colorC) {
        if (!flashingLeds[i].beenPassed) {
          // First pass logic
          flashingLeds[i].beenPassed = true;
          flashingLeds[i].passedClockwise = isClockwise;
          flashingLeds[i].hasLeftPixel = false; // Reset this flag
          startPlayback(secondCount, sizeof(secondCount));
        } 

        if (flashingLeds[i].hasLeftPixel) {
          // Second pass logic, only if we have left the pixel since the first pass
          if (flashingLeds[i].passedClockwise == isClockwise) {
            CollectLed(i, specialScoring);
            startPlayback(goCount, sizeof(goCount));
          } else {
            TurnOffLed(i);
            startPlayback(miss, sizeof(miss));
          }
        }
        continue;
      }

      unsigned long currentTime = millis();
      if (currentTime - flashingLeds[i].passedTime >= incorrectResetTime) {
        flashingLeds[i].beenPassed = false;
        // Serial.println("beenPassed set to false");
      }

      bool correctDirection = (flashingLeds[i].color == colorA && isClockwise) || (flashingLeds[i].color == colorB && !isClockwise);

      if (correctDirection) {
        if (!flashingLeds[i].beenPassed) {
          CollectLed(i, commonScoring);
          startPlayback(hit, sizeof(hit));
          //Serial.println("Succesful collection");
        }else{
          //Serial.println("Been passed cant collect");
        }
      } else {
        //Serial.println("been passed = true");
        flashingLeds[i].beenPassed = true;
        flashingLeds[i].passedTime = millis();
      }
    }else{
      // This is the case when delta > 1 (not aiming at the LED)
      if (flashingLeds[i].color == colorC && flashingLeds[i].beenPassed && !flashingLeds[i].hasLeftPixel) {
        // Need to be at least 3 pixels away to count as "left"
        flashingLeds[i].hasLeftPixel = true;
      }
    }
  }
}

void CollectLed(int index, uint8_t baseScore) {
  for (int i = 0; i < MAX_FLASHING_LEDS; i++) {
    if (!flashingLeds[i].active) continue;

    if(flashingLeds[i].color != colorC){
      flashingLeds[i].beenPassed = false;
    }
  }

  if (combo < 16) {
    combo = combo * 2;
  }
  score = score + (baseScore * combo);
  if (score > 9999) score = 9999;
  sprintf(buf, "%04d", score);
  scoreDisplay.displayStr(buf);


  TurnOffLed(index);
}

void TurnOffLed(int index){
  flashingLeds[index].active = false;
  strip.setPixelColor(flashingLeds[index].pixel, 0);  //turn off LED
  flashingLeds[index].ledOn = false;
  flashingLeds[index].hasLeftPixel = false;
  flashingLeds[index].beenPassed = false;
  flashingLeds[index].passedClockwise = false;

  strip.show();
}

int GetRandomPixel() {  // Get a random pixel and make sure its not been used recently:
  uint8_t randomPixel;
  bool isTooClose;
  uint8_t attempts = 0;

  do {
    randomPixel = random(0, numPixels);  // Generate a random pixel
    isTooClose = false;

      // Check proximity to aimedAtLed (with wraparound)
      int distToAimed = abs((int)randomPixel - (int)aimedAtLed);
      int wrappedDistToActive = min(distToAimed, numPixels - distToAimed);
      if (wrappedDistToActive <= aimedLedDeadzone) {
        isTooClose = true;
      }

    // Check distance from all active flashing LEDs
    for (int i = 0; i < MAX_FLASHING_LEDS && !isTooClose; i++) {
      if (!flashingLeds[i].active) continue;

      int distToActive = abs((int)randomPixel - (int)flashingLeds[i].pixel);
      int wrappedDistToActive = min(distToActive, numPixels - distToActive);

      if (wrappedDistToActive <= existingLedsDeadzone) {
        isTooClose = true;
        break;
      }


    }
    attempts++;
    if (attempts > 10) break;  // Prevent infinite loops if LEDs are full
  } while (isTooClose);       // Loop until randomPixel is a pixel not too close to existing pixels/marker

  return randomPixel;
}

void startFlashingLED(int pixel) {
  static uint32_t lastColor = 0;
  static int sameColorCount = 0;

  for (int i = 0; i < MAX_FLASHING_LEDS; i++) {  
    if (!flashingLeds[i].active) {                // Find an inactive LED slot
      flashingLeds[i].active = true;
      flashingLeds[i].pixel = pixel;
      flashingLeds[i].startTime = millis();       // Record the start time
      flashingLeds[i].lastToggleTime = millis();  // Record the toggle time
      flashingLeds[i].ledOn = false;
      flashingLeds[i].beenPassed = false;
      flashingLeds[i].passedClockwise = false;
      flashingLeds[i].hasLeftPixel = false;

      flashingLeds[i].color = DetermineColor(CheckForInbetweenSpawn(pixel));
      flashingLeds[i].delayTime = (flashingLeds[i].color == colorC) ? specialLifespan : normalLifespan * initialBlinkProportion;
      return;
    }
  }
  // No available slots
}

bool CheckForInbetweenSpawn(int randomPixel){
  int nearestLed = -1;
  int minDistance = numPixels;

  // Find the nearest active LED in the specified direction
  for (int i = 0; i < MAX_FLASHING_LEDS; i++) {
      if (!flashingLeds[i].active) continue;
      int ledPos = flashingLeds[i].pixel;
      int distance = 0;

      if (isClockwise) {
        distance = (aimedAtLed - ledPos + numPixels) % numPixels;
        if (distance > 0 && distance < minDistance) {
          minDistance = distance;
          nearestLed = ledPos;
          //Serial.print("Nearest led: ");
          //Serial.println(nearestLed);
        }
      } else {
        distance = (ledPos - aimedAtLed + numPixels) % numPixels;
        if (distance > 0 && distance < minDistance) {
          minDistance = distance;
          nearestLed = ledPos;
          //Serial.print("Nearest led: ");
          //Serial.println(nearestLed);
        }
      }
  }

  // Get all LEDs between marker and nearest LED 
  bool found = false;
  if (nearestLed != -1) {
    int pos = aimedAtLed;
    while (true) {
      // Move in the correct direction
      pos = isClockwise ? (pos + 1) % numPixels : (pos - 1 + numPixels) % numPixels;
      if (pos == nearestLed) break;
      if (pos == randomPixel) {
        found = true;
        break;
      }
    }
  }
  return found;
}

uint32_t DetermineColor(bool foundInbetween) {
  uint8_t randVal = random(100);  // 0–99

  if (randVal < colorCRarity) {
    return colorC;
  }

  if(foundInbetween){
    return isClockwise ? colorB : colorA;
  }

  return (random(2) == 0) ? colorA : colorB;
}

void updateFlashingLEDs() {
  unsigned long currentTime = millis();                                 // Get current time

  for (int i = 0; i < MAX_FLASHING_LEDS; i++) {
    if (!flashingLeds[i].active) continue;                              // Skip inactive LEDs

    FlashingLED &led = flashingLeds[i];       

    unsigned long lifeSpan = (led.color == colorC) ? specialLifespan : normalLifespan;


    if (currentTime - led.startTime >= lifeSpan) {                      // Check if LED lifespan is up
      strip.setPixelColor(led.pixel, 0);                                // Turn off LED
      led.ledOn = false;
      led.active = false;
      strip.show();                                                     // Update the strip
      startPlayback(miss, sizeof(miss));
      ResetCombo();
    
      continue;
    }
    

    if (currentTime - led.lastToggleTime >= led.delayTime) {      // Check if its time to toggle
      led.lastToggleTime = currentTime;                           // Update the last toggle time
      led.ledOn = !led.ledOn;                                     // Toggle the LED state

      if (led.ledOn) {
        strip.setPixelColor(led.pixel, led.color);                // LED on
      } else {
        strip.setPixelColor(led.pixel, 0);                        // LED off
        led.delayTime = max(minBlinkDelay, led.delayTime * blinkAcceleration);             // Decrease the delay to flash faster and faster
      }
      strip.show(); 
    }
  }
}

void ResetCombo(){
  combo = 1;
}

void theaterChase() {
  unsigned long currentMillis = millis();

  // Determine color based on current time
  useAltColor = (currentMillis / colorChangeInterval) % 2;
  uint32_t chase_color = useAltColor ? colorA : colorB;

  if (currentMillis - chasePreviousMillis >= blinkFrequency) {
    chasePreviousMillis = currentMillis;

    for (uint16_t i = 0; i < strip.numPixels(); i += 3) {
      strip.setPixelColor(i + chase_q, chase_color);
    }
    strip.show();

    for (uint16_t i = 0; i < strip.numPixels(); i += 3) {
      strip.setPixelColor(i + chase_q, 0);
    }

    chase_q = (chase_q + 1) % 3;
  }
}

// void checkMagnetPresence()
// {  
//   //This function runs in the setup() and it locks the MCU until the magnet is not positioned properly

//   while((magnetStatus & 32) != 32) //while the magnet is not adjusted to the proper distance - 32: MD = 1
//   {
//     magnetStatus = 0; //reset reading

//     Wire.beginTransmission(0x36); //connect to the sensor
//     Wire.write(0x0B); //figure 21 - register map: Status: MD ML MH
//     Wire.endTransmission(); //end transmission
//     Wire.requestFrom(0x36, 1); //request from the sensor

//     while(Wire.available() == 0); //wait until it becomes available 
//     magnetStatus = Wire.read(); //Reading the data after the request

//     Serial.print("Magnet status: ");
//     Serial.println(magnetStatus); //print it in binary so you can compare it to the table (fig 21)      
//   }
//   //Status register output: 0 0 MD ML MH 0 0 0  
//   //MH: Too strong magnet - 100111 - DEC: 39 
//   //ML: Too weak magnet - 10111 - DEC: 23     
//   //MD: OK magnet - 110111 - DEC: 55

//   Serial.println("Magnet found!");
//   delay(1000); 
// }      